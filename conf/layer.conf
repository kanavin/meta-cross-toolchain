## conf/layer.conf
```bitbake
# We have a conf and classes directory, add to BBPATH
BBPATH .= ":${LAYERDIR}"

# We have recipes-* directories, add to BBFILES
BBFILES += "${LAYERDIR}/recipes-*/*/*.bb \
            ${LAYERDIR}/recipes-*/*/*.bbappend"

BBFILE_COLLECTIONS += "meta-cross-toolchain"
BBFILE_PATTERN_meta-cross-toolchain = "^${LAYERDIR}/"
BBFILE_PRIORITY_meta-cross-toolchain = "6"

LAYERDEPENDS_meta-cross-toolchain = "core"
LAYERSERIES_COMPAT_meta-cross-toolchain = "kirkstone"
```
